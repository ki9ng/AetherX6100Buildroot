## br2_external/package/libx6100js8/Config.in
```kconfig
config BR2_PACKAGE_LIBX6100JS8
	bool "libx6100js8"
	help
	  JS8 protocol engine for the Xiegu X6100. Provides the
	  encoder side (libx6100js8.so) of the JS8 mode, used by
	  x6100_gui for the JS8 POTA self-spot feature.

	  https://github.com/ki9ng/x6100-js8-engine
```
